/*
 * Hand-wired pinout for the left half (ProMicro nRF52840 / nice!nano v2 clone).
 * Pins are nRF52840 GPIOs as printed on the board: P0.xx -> &gpio0 xx, P1.xx -> &gpio1 xx.
 */

&kscan0 {
    diode-direction = "col2row";

    // top to bottom; row 4 = thumb keys (columns 4, 5, 6)
    row-gpios
        = <&gpio1 0  (GPIO_ACTIVE_HIGH | GPIO_PULL_DOWN)>  // P1.00
        , <&gpio0 11 (GPIO_ACTIVE_HIGH | GPIO_PULL_DOWN)>  // P0.11
        , <&gpio1 4  (GPIO_ACTIVE_HIGH | GPIO_PULL_DOWN)>  // P1.04
        , <&gpio1 6  (GPIO_ACTIVE_HIGH | GPIO_PULL_DOWN)>  // P1.06
        ;

    // outer edge (TAB/ESC) to center (T/G/B)
    col-gpios
        = <&gpio0 2  GPIO_ACTIVE_HIGH>  // P0.02
        , <&gpio1 15 GPIO_ACTIVE_HIGH>  // P1.15
        , <&gpio1 13 GPIO_ACTIVE_HIGH>  // P1.13
        , <&gpio1 11 GPIO_ACTIVE_HIGH>  // P1.11
        , <&gpio0 10 GPIO_ACTIVE_HIGH>  // P0.10 (NFC pin)
        , <&gpio0 9  GPIO_ACTIVE_HIGH>  // P0.09 (NFC pin)
        ;
};
