## boards/shields/my_corne/Kconfig.shield
```kconfig
config SHIELD_MY_CORNE_LEFT
    def_bool $(shields_list_contains,my_corne_left)

config SHIELD_MY_CORNE_RIGHT
    def_bool $(shields_list_contains,my_corne_right)

config SHIELD_MY_CORNE_DONGLE
    def_bool $(shields_list_contains,my_corne_dongle)
```
