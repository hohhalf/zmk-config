#include "my_corne.dtsi"

&default_transform {
    col-offset = <6>;
};

&five_column_transform {
    col-offset = <6>;
};

&kscan0 {
    // top to bottom; row 4 = thumb keys (columns 1, 2, 3 from center)
    row-gpios
        = <&gpio0 29 (GPIO_ACTIVE_HIGH | GPIO_PULL_DOWN)>  // P0.29
        , <&gpio1 13 (GPIO_ACTIVE_HIGH | GPIO_PULL_DOWN)>  // P1.13
        , <&gpio0 10 (GPIO_ACTIVE_HIGH | GPIO_PULL_DOWN)>  // P0.10
        , <&gpio0 9  (GPIO_ACTIVE_HIGH | GPIO_PULL_DOWN)>  // P0.09
        ;

    // center (Y/H/N) to outer edge (BSPC)
    col-gpios
        = <&gpio1 6  GPIO_ACTIVE_HIGH>  // P1.06
        , <&gpio1 4  GPIO_ACTIVE_HIGH>  // P1.04
        , <&gpio0 11 GPIO_ACTIVE_HIGH>  // P0.11
        , <&gpio1 0  GPIO_ACTIVE_HIGH>  // P1.00
        , <&gpio0 24 GPIO_ACTIVE_HIGH>  // P0.24
        , <&gpio0 22 GPIO_ACTIVE_HIGH>  // P0.22
        ;
};
